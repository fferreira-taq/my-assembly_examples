;>>> ESSE PROGRAMA FOI DESENVOLVIDO PARA FINS DIDÁTICOS... O AUTOR NÃO SE RESPONSABILIZA POR NENHUM DANO
;>>> QUE POSSA OCORER COM A NOTA DO REPRODUTOR... ERNO B. B. JUNIOR...

	#INCLUDE	<p16F628A.inc>	; MICROCONTROLADOR UTILIZADO

	;;>> CONFIGURAÇÃO PARA GRAVAÇÃO >>> COM ESSA LINHA NÃO É NECESSÁRIO CONFIGURAR O CONFIGBITS...
	__CONFIG   _CP_OFF & _DATA_CP_OFF & _LVP_OFF & _BOREN_OFF & _MCLRE_OFF & _WDT_OFF & _PWRTE_ON & _INTOSC_OSC_NOCLKOUT 


#DEFINE	BANK1	BSF	STATUS,RP0 	; SELECIONA BANK1 DA MEMORIA RAM
#DEFINE	BANK0	BCF	STATUS,RP0	; SELECIONA BANK0 DA MEMORIA RAM


	CBLOCK	0X20

	W_TEMP
	STATUS_TEMP
	CONT1
	CONT2
	CONT3
	CONT4
	COMANDO				; IDENTIFICA O COMANDO A SER REALIZADO
	
	ENDC

;**************VETOR DE RESET**************;

	 	ORG	0X00

	CLRF	COMANDO
	GOTO	INICIO

; * * * * * * * * * * * * * * * * * * * * * * * * * * * * * * * * * * * * *
; *                       TRATAMENTO DAS INTERRUPÇÕES                     *
; * * * * * * * * * * * * * * * * * * * * * * * * * * * * * * * * * * * * *
		ORG	0X04

	MOVWF	W_TEMP		; SALVA O REGISTRADOR W
	SWAPF	STATUS,W
	MOVWF	STATUS_TEMP	; SALVA O STATUS DO SISTEMA

	BTFSC	PIR1,RCIF	; FOI INTERRUPÇÃO POR RECEPÇÃO NA USART?
	GOTO	RECEPCAO	; SIM, TRATA
	GOTO	SAI_INT		; RETORNA DA INTERRUPÇÃO

RECEPCAO:

	MOVF	RCREG,W			; BITE RECEBIDO SALVO...
	MOVWF	COMANDO			; ...NO REGISTRADOR COMANDO
	NOP	
	BCF	PIR1,RCIF		; LIMPA A FLEG QUE A INTERRUPÇÃO COLOCOU EM "1"

; * * * * * * * * * * * * *
; * ENVIA O DADO RECEBIDO *	>>>>>>>> PARA ENVIAR PELO TX EM OUTRA PARTE DO PROGRAMA DEVERÁ SER REPETIDO O TRECHO ABAIXO
; * * * * * * * * * * * * *
	BANK1	
	BTFSS	TXSTA,TRMT
	GOTO	$-1
	BCF	TXSTA,TRMT
	BANK0
	MOVWF	TXREG
	BANK1	
	BTFSS	TXSTA,TRMT
	GOTO	$-1
	BCF	TXSTA,TRMT
	BANK0
;;;>>> FIM DO TRECHO DE ENVIO

	GOTO	INICIO

SAI_INT:

	SWAPF	STATUS_TEMP,W
	MOVWF	STATUS		; RETORNA O STATUS DO SISTEMA
	SWAPF	W_TEMP,F	; RETORNA O REGISTRADOR F
	SWAPF	W_TEMP,W	; RETORNA O REGISTRADOR W

	RETFIE

; * * * * * * * * * * * * * * * * * * * * * * * * * * * * * * * * * * * * *
; *                        INICIO DO PROGRAMA                             *
; * * * * * * * * * * * * * * * * * * * * * * * * * * * * * * * * * * * * *

INICIO: 

	BANK1

	MOVLW	B'00000010'
	MOVWF	TRISB

	MOVLW	B'00000000'
	MOVWF	TRISA	

	MOVLW	B'10000000'
	MOVWF	OPTION_REG

	MOVLW	B'11000000'		;INTERRUPÇÃO POR PERIFÉRICOS
	MOVWF	INTCON

	MOVLW	B'00100000'		;HABILITA INTERRUPÇÃO DE RECEPÇÃO DA USART
	MOVWF	PIE1

	MOVLW	B'00100000'		;>>>>> O bit 2->0 Low speed... bit 2->1 High speed
	MOVWF	TXSTA			;CONFIGURA USART
							;HABILITA TRANSMISSÃO
							;MODO ASSÍNCRONO
							;TRANSMISSÃO DE 8 BITS
							;LOW SPEED BAUD RATE

;************************>>> O BAUD RATE DO PROGRAMA EM C++ TAMBÉM TEM QUE ESTAR EM 1200...
;************************>>> ISSO SE FAZ NA TBACKGROUNDCOMMTHREAD... QUE É UMA CPP... VAI EM ARQUIVO, ABRIR E LÁ ESTARÁ ELA...
;************************>>> DAÍ É SÓ MUDAR E COLOCAR PARA FUNCIONAR...

	MOVLW	.51
	MOVWF	SPBRG			;DEFINE BAUD RATE PARA 1200bps

	BANK0

	MOVLW	B'10010000'		
	MOVWF	RCSTA			;CONFIGURA USART
							;HABILITA RECEPÇÃO
							;RECEPÇÃO DE 8 BITS
							;RECEPÇÃO CONTÍNUA
							;DESABILITA ADDRESS DETECT

DECODIFICA:

	MOVLW		B'01000001'		; A?
	SUBWF		COMANDO,W
	BTFSC		STATUS,Z
	GOTO		COMANDO1

	MOVLW		B'01000010'		; B?
	SUBWF		COMANDO,W
	BTFSC		STATUS,Z
	GOTO		COMANDO2

	MOVLW		B'01000011'		; C?
	SUBWF		COMANDO,W
	BTFSC		STATUS,Z
	GOTO		STOP

	MOVLW		B'01000100'		; D?
	SUBWF		COMANDO,W
	BTFSC		STATUS,Z
	GOTO		COMANDO3

	MOVLW		B'01000101'		; E?
	SUBWF		COMANDO,W
	BTFSC		STATUS,Z
	GOTO		COMANDO4

;SE NÃO FOR NENHUMA DAS ALTERNATIVAS ACIMA.... ELE SIMPLESMENTE NÃO FAZ NADA...
NADA
	NOP
	NOP
	NOP
	GOTO		$-3


STOP
	BCF			PORTA,0
	BCF			PORTA,1
	GOTO		NADA

COMANDO1
	BSF			PORTA,0
	BCF			PORTA,1
	GOTO		NADA

COMANDO2
	BCF			PORTA,0
	BSF			PORTA,1
	GOTO		NADA
COMANDO3
;ARRUMA OUTRAS PORTAS PARA MEXER...
	GOTO		NADA
COMANDO4
;ARRUMA OUTRAS PORTAS PARA MEXER...
	GOTO		NADA
	END
